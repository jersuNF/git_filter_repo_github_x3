## messaging/Kconfig
```kconfig
menuconfig MESSAGING
	bool "Messaging module"
	select COLLAR_PROTOCOL
	select POLL
	help
	  Enable messaging module
	default y


if MESSAGING

	module = MESSAGING
        module-str = Messaging module
        source "subsys/logging/Kconfig.template.log_config"

	config MESSAGING_THREAD_STACK_SIZE
		int "Size of the message processing thread"
		default 8192

	config MESSAGING_THREAD_PRIORITY
		int "Priority of the message processing thread"
		default 3
		help
		  A cooperative thread has a negative priority value. 
		  Once it becomes the current thread, a cooperative thread 
		  remains the current thread until it performs an action 
		  that makes it unready.
		  A preemptible thread has a non-negative priority value. 
		  Once it becomes the current thread, a preemptible thread 
		  may be supplanted at any time if a cooperative thread, 
		  or a preemptible thread of higher or equal priority, 
		  becomes ready.

	config MESSAGING_SEND_THREAD_STACK_SIZE
		int "Size of the send to server queue thread"
		default 8192

	config MESSAGING_SEND_THREAD_PRIORITY
		int "Priority of the send to server queue thread"
		default 3

	config CC_ACK_TIMEOUT_SEC
	    int "Timeout when waiting for ack from cellular controller"
	    default 3
	config APP_FOTA_WDT_MINUTES
		int "Application wdt for maximum time in minutes FOTA can take (hang workaround)"
		default 5
	config APP_FOTA_FAILURES_BEFORE_REBOOT
                int "Number of consecutive FOTA attempts before the App reboots (hang workaround)"
                default 10
	config WDT_MODULE_MESSAGING_TIME_SECONDS
		int "watchdog trigger time for MODULE_MESSAGING"
		default 120 #2 min
	config WDT_MODULE_KEEP_ALIVE_TIME_SECONDS
		int "watchdog trigger time for MODULE_KEEP_ALIVE"
		default 10800 #3 hours
	config WDT_MODULE_RECV_TCP_TIME_SECONDS
		int "watchdog trigger time for MODULE_RECV_TCP"
		default 10800 #3 hours
	config WDT_KEEP_ALIVE_NUM_POLLS
		int "WDT will kick in if no connection for 15 polls"
		default 15
	config WDT_KEEP_MAX_TIME_SECONDS
		int "Maximum watchdog time"
		default 259200 #3 days

	menu "Message Queues"
		config MSGQ_BLE_CTRL_SIZE
		int "Size of the bluetooth control command data received"
		default 4
		config MSGQ_BLE_CMD_SIZE
		int "Size of the bluetooth commands data received"
		default 4
		config MSGQ_BLE_DATA_SIZE
		int "Size of the bluetooth connection data received"
		default 4
		config MSGQ_LTE_PROTO_SIZE
		int "Size of the GSM modem LTE connection protobuf message"
		default 4
	endmenu

	menu "FW_EVENTS"
	rsource "./../../events/fw_upgrade/Kconfig"
	endmenu # FW_EVENTS
endif
```

## movement_controller/Kconfig
```kconfig
menuconfig MOVE_CONTROLLER
	bool "Movement controller"
	help
	  Movement controller module
	select SENSOR
	select LIS2DW
	select LIS2DW_TRIGGER
	default y

if MOVE_CONTROLLER
	module = MOVE_CONTROLLER
	module-str = MOVEMENT Controller
	source "subsys/logging/Kconfig.template.log_config"

	config MOVEMENT_THREAD_STACK_SIZE
		int "Stack size of the movement processing thread"
		default 2048

	config MOVEMENT_THREAD_PRIORITY
		int "Priority of the movement processing thread"
		default 1
		help
		  A cooperative thread has a negative priority value. 
		  Once it becomes the current thread, a cooperative thread 
		  remains the current thread until it performs an action 
		  that makes it unready.
		  A preemptible thread has a non-negative priority value. 
		  Once it becomes the current thread, a preemptible thread 
		  may be supplanted at any time if a cooperative thread, 
		  or a preemptible thread of higher or equal priority, 
		  becomes ready.

	config MOVEMENT_TIMEOUT_SEC
		int "Timeout of the movement controller which fires an event if timeout"
		default 120

	config ACC_MSGQ_SIZE
	int "Size of number of acc data elements"
	default 32

	config MOVE_CONTROLLER_LOG_LEVEL
		int "Log level for the messaging module"
		default 2
endif
```

## msg/Kconfig
```kconfig
# Copyright (c) 2021 Nofence AS

module = MSG
module-str = Message logger
source "subsys/logging/Kconfig.template.log_config"

config MSG_BUF_SIZE
	int "Transport interface buffer size"
	default 2048
	help
	  Size of transmit/receive buffer for transfer between interfaces.
```

## nclogs/Kconfig
```kconfig
menuconfig NCLOGS
	bool "NCLogs module"
	help
	  Enable trice module
	default y

if NCLOGS
    config NCLOG_BUFFER_SIZE
        int "Size of the circular log buffer"
        default 1024

    config NCLOG_BUFFER_USED_UP_THRESHOLD_PERCENTAGE
          int "Size of the circular log buffer"
          default 80

    config NCLOG_DEFAULT_LEVEL
        int "Default log level"
        default 2 # eNCLOG_LVL_ERR
endif
```

## nofence_watchdog/Kconfig
```kconfig
menuconfig NOFENCE_WATCHDOG_ENABLE
	bool "Enable watchdog"
	select NOFENCE_WATCHDOG
	default y

if NOFENCE_WATCHDOG_ENABLE
	module = NOFENCE_WATCHDOG
	module-str = Nofence-Watchdog
	source "subsys/logging/Kconfig.template.log_config"

	config NOFENCE_WATCHDOG_TIMEOUT_SEC
		int "Application watchdog timeout in seconds"
		default 4320

	config SIZE_WDT_MODULE_NAMES
		int "size of module name string"
		default 30

	config NUM_WDT_MODULES
		int "max number of wdt modules"
		default 10
	menu "ERROR_HANDLER"
    	rsource "./../../modules/error_handler/Kconfig"
	endmenu # ERROR_HANDLER
endif # WATCHDOG_ENABLE
```

## power_manager/Kconfig
```kconfig
# Copyright (c) 2021 Nofence AS


menuconfig POWER_MANAGER
        bool "Enable Power Manager module"
	select LOG
        default y

if POWER_MANAGER
        module = PWR_MODULE
        module-str = PWR module
        source "subsys/logging/Kconfig.template.log_config"

        module = BATTERY
        module-str = Battery logging
        source "subsys/logging/Kconfig.template.log_config"

        module = CHARGING
        module-str = Charging logging
        source "subsys/logging/Kconfig.template.log_config"

        config BATTERY_POLLER_WORK_SEC
        int "Seconds between modem poll"
        default 1

        config BATTERY_THRESHOLD
        int "Battery hysteresis in mV"
        default 50

        config BATTERY_FULL_MV
        int "Represent 100 % battery to the users. NB: This is not the max voltage capacity of the battery. NOTE: Value must match server"
        default 4100

        config BATTERY_EMPTY_MV
        int "Represent 0 % battery to the users. NB: This is not the min voltage capacity of the battery. NOTE: Value must match server"
        default 3400

        config BATTERY_LOW
        int "Battery threshold defined in mV to enter low state"
        default 3450

        config BATTERY_CRITICAL
        int "Battery threshold defined in mV to enter critical state"
        default 3250

        config BATTERY_MOVING_AVERAGE_SAMPLES
        int "Number of moving average samples to be considered. Higher number gives smoother voltage change"
        default 3

        config SHUTDOWN_TIMER_SEC
        int "Seconds to wait before reboot"
        default 5
        
        config CURRENT_MOVING_AVERAGE_SAMPLES
        int "Number of moving average samples to be considered for current measurement. Higher number gives smoother voltage change"
        default 32

        config CHARGING_POLLER_WORK_SEC
        int "Seconds between modem poll"
        default 1

        config CHARGING_THRESHOLD_START
        int "Threshold to start charging, defined in mV"
        default 4000

        config CHARGING_THRESHOLD_STOP
        int "Threshold to stop charging, defined in mV"
        default 4200

        
endif
```

## storage_controller/Kconfig
```kconfig
menuconfig STORAGE_CONTROLLER
        bool "Enable storage controller module"
	select POLL
        default y

if STORAGE_CONTROLLER
	module = STORAGE_CONTROLLER
	module-str = STG module
	source "subsys/logging/Kconfig.template.log_config"

	config STORAGE_SECTOR_SIZE
		hex "Size of the sectors that FCB uses for seq/ano/pasture data"
		default 0x1000

	config MUTEX_READ_WRITE_TIMEOUT
		int "Number of ms before we timeout waiting for semaphore."
		default 10000
	
	config STG_CONFIG_LOG_LEVEL
		int "Default log level for STG Config"
		default 2
	config STG_CONFIG_DEBUG_SEND_WRITE_ERRORS
	        bool "Only used for debugging, send write errors in poll"
	        default true
endif
```

## time_use/Kconfig
```kconfig
menuconfig TIME_USE
	bool "time use accumulator"
	select COLLAR_PROTOCOL
	select POLL
	help
	  Enable time use accumulator
	default y


if TIME_USE
	config TIME_USE_LOG_LEVEL
		int "Log level for the time_use module"
		default 4

	config TIME_USE_THREAD_STACK_SIZE
		int "Size of the time_use processing thread"
		default 1024

	config TIME_USE_THREAD_PRIORITY
		int "Priority of the time_use processing thread"
		default 14

	config TIME_USE_RESOLUTION_MS
		int "histograms update resolution in milliseconds"
		default 4000

endif
```

## watchdog/Kconfig
```kconfig
menuconfig WATCHDOG_ENABLE
	bool "Enable watchdog"
	select WATCHDOG
	depends on BEACON_SCAN_ENABLE
	default y

if WATCHDOG_ENABLE

config WATCHDOG_TIMEOUT_SEC
	int "Application watchdog timeout in seconds"
	default 300

endif # WATCHDOG_ENABLE

module = WATCHDOG
module-str = Watchdog
source "subsys/logging/Kconfig.template.log_config"
```
