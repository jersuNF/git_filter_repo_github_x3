## Kconfig
```kconfig
# Kconfig options for logger 

module = STORAGE_MODULE
module-str = STORAGE module
source "subsys/logging/Kconfig.template.log_config"

module = MODULES_COMMON
module-str = Common modules
source "subsys/logging/Kconfig.template.log_config"
```

## amc/Kconfig
```kconfig
menuconfig ANIMAL_MONITOR_CONTROL
	bool "AMC module"
	select POLL
	help
	  Enable animal monitor control module
	default y


if ANIMAL_MONITOR_CONTROL
	config AMC_LOG_LEVEL
		int "Log level for the messaging module"
		default 4
	
	config STATIC_GNSSDATA_SIZE
		int "Data size of the cached GNSS data"
		default 64
	
	config STATIC_FENCEDATA_SIZE
		int "Data size of the cached GNSS data"
		default 64

	config AMC_CALCULATION_SIZE
		int "Stack size of the calculation thread"
		default 4096

	config AMC_CALCULATION_PRIORITY
		int "Priority of the calculation thread"
		default -1
		help
		  A cooperative thread has a negative priority value. 
		  Once it becomes the current thread, a cooperative thread 
		  remains the current thread until it performs an action 
		  that makes it unready.
		  A preemptible thread has a non-negative priority value. 
		  Once it becomes the current thread, a preemptible thread 
		  may be supplanted at any time if a cooperative thread, 
		  or a preemptible thread of higher or equal priority, 
		  becomes ready.
endif
```

## amc/lib/Kconfig
```kconfig
config AMC_LIB_LOG_LEVEL
	int "Log level for the AMC LIB modules"
	default 3

config FENCE_CACHE_TIMEOUT_SEC
	int "Timeout in seconds when we try to access the cache"
	default 5
	
config GNSS_CACHE_TIMEOUT_SEC
	int "Timeout in seconds when we try to access the cache"
	default 5

config ZONE_CAUTION_DIST
	int "Caution zone distance from border in dm"
	default -110
	
config ZONE_CAUTION_HYST
	int "Hysteresis of caution zone distance in dm"
	default 10

config ZONE_PREWARN_DIST
	int "Prewarn zone distance from border in dm"
	default -60
	
config ZONE_PREWARN_HYST
	int "Hysteresis of prewarn zone distance in dm"
	default 10

config ZONE_WARN_DIST
	int "Warn zone distance from border in dm"
	default 0
	help
	  No corrections can be started with a distance-to-pasture less than 
	  this value. However, due to dynamic limits and GPS limitations, 
	  warnings can be started at a greater distance.
	
config ZONE_WARN_HYST
	int "Hysteresis of warn zone distance in dm"
	default 0

config MAX_PSM_FIX_AGE
	int "Maximum number of seconds before PSM fix lead to no zone"
	default 3

config ZONE_MIN_TIME_SINCE_RESET
	int "Minimum time in milliseconds since GNSS reset for further processing of position"
	default 10000

config ZONE_PSM_LEAST_TIME
	int "Minimum time in milliseconds for changing from PSM mode"
	default 15000

config ZONE_LEAST_TIME
	int "Minimum time in milliseconds for zone duration before resetting after position is uncertain"
	default 6000

config GNSS_TIMEOUT
	int "Timeout in milliseconds before position data is considered unreliable"
	default 1500

config GNSS_NUMSV_LIMIT
	int "Minimum number of satellites required"
	default 6

config GNSS_HDOP_LIMIT
	int "Maximum horizontal dilution of precision in dm"
	default 200

config GNSS_HACC_LIMIT
	int "Maximum horizontal accuracy in dm"
	default 35

config GNSS_CACC_LIMIT
	int "Maximum course heading accuracy in centidegrees, deg*100"
	default 36000
```

## ble/Kconfig
```kconfig
# Copyright (c) 2021 Nofence AS

module = BLE_CONTROLLER
module-str = BLE Controller
source "subsys/logging/Kconfig.template.log_config"

module = BLE_SERVICE
module-str = BLE Service
source "subsys/logging/Kconfig.template.log_config"

config NOFENCE_SERIAL_NUMBER
	int "Nofence serial number"
	default 673


config NOFENCE_FIRMWARE_NUMBER
	int "Nofence firmware number"
	default 1

config NOFENCE_HARDWARE_NUMBER
	int "Nofence firmware number"
	default 14

config MSG_BUF_SIZE
	int "Transport interface buffer size"
	default 2048
	help
	  Size of transmit/receive buffer for transfer between interfaces.

config BEACON_SHORTEST_DISTANCE
	bool "Use the shortest distance across all Beacons"
	default y

config BEACON_DISTANCE_MAX
	int "Max distance for a Beacon to be considerd. Must be less than 255"
	default 50

config BEACON_LOW_LIMIT
	int "Low limit distance measurement. Given in meters"
	default 10

config BEACON_HIGH_LIMIT
	int "High limit distance measurement. Given in meters"
	default 15

config BEACON_MAX_MEASUREMENTS
	int "Max measurements per Beacon"
	default 8

config BEACON_MAX_BROADCASTERS
	int "Max number of Beacons to scan for"
	default 4

config BEACON_MAX_MEASUREMENT_AGE
	int "Max age of measurements in buffer. Given in seconds"
	default 10

config BEACON_SCAN_DURATION
	int "Set the beacon scan duration in seconds"
	default 14

config BEACON_SCAN_PERIODIC_INTERVAL
	int "Set the periodic interval to start beacon scanner. In seconds"
	default 60
```

## buzzer/Kconfig
```kconfig
menuconfig BUZZER
	bool "Buzzer module"
	help
	  Buzzer module
	default y

if BUZZER
	module = BUZZER
	module-str = BUZZER Controller
	source "subsys/logging/Kconfig.template.log_config"

	config BUZZER_THREAD_SIZE
		int "Size of the poller thread"
		default 8192

	config BUZZER_THREAD_PRIORITY
		int "Priority of the poller thread"
		default -2
		help
		  A cooperative thread has a negative priority value. 
		  Once it becomes the current thread, a cooperative thread 
		  remains the current thread until it performs an action 
		  that makes it unready.
		  A preemptible thread has a non-negative priority value. 
		  Once it becomes the current thread, a preemptible thread 
		  may be supplanted at any time if a cooperative thread, 
		  or a preemptible thread of higher or equal priority, 
		  becomes ready.

	config BUZZER_WARN_ZONE_FREQ_INTERVAL
		int "How often and long we play the NORMAL warn zone frequency in ms."
		default 2000

	config BUZZER_MAX_WARN_ZONE_FREQ_INTERVAL
		int "How often and long we play the MAX warn zone frequency in ms."
		default 2000

	config BUZZER_UPDATE_WARN_FREQ_TIMEOUT_SEC
		int "Timeout if we do not get new warn zone freq from AMC."
		default 1

	config BUZZER_LONGEST_NOTE_SUSTAIN
		int "Maximum length of sustain notes in s, prevents timeouts on sems."
		default 10
		  
	menu "Message Queues"
		config MSGQ_SOUND_EVENT_SIZE
		int "Size of the message queue for sound events"
		default 4
	endmenu

	menu "ERROR_HANDLER"
    	rsource "./../../modules/error_handler/Kconfig"
	endmenu # ERROR_HANDLER
endif
```

## cellular_controller/Kconfig
```kconfig
menuconfig CELLULAR_CONTROLLER
	bool "Cellular controller module"
	default y

if CELLULAR_CONTROLLER
	config CELLULAR_KEEP_ALIVE_STACK_SIZE
		int "Stack size for the keep alive thread."
		default 1024
		help
		This stack is used by the keep alive thread.
	
	config CELLULAR_KEEP_ALIVE_THREAD_PRIORITY
		int "Priority of the connection keep-alive thread"
		default 5
		help
		This priority is used by the Cellular Controller keep-alive thread.

	config CELLULAR_CONTROLLER_VERBOSE
		bool "Verbose output from cellular controller"
		default n

	module = CELLULAR
	module-str = CELLULAR
	source "subsys/logging/Kconfig.template.log_config"

	config MESSAGING_ACK_TIMEOUT_MSEC
	    int "Timeout when waiting for ack from messaging (milliseconds)"
        default 1200


	config RECV_BUF_MAX
	    int "max size of messages to be received"
	    default 386

	config RECV_THREAD_STACK_SIZE
	    int
	    default 1024

	config RECV_THREAD_PRIORITY
	    int
	    default 7

	config SEND_THREAD_STACK_SIZE
        int
        default 1024

    config SEND_THREAD_PRIORITY
        int
        default 6

endif
```

## collar_protocol/zephyr/Kconfig
```kconfig
menuconfig COLLAR_PROTOCOL
	bool "Collar protocol definitions"
	help
	  Enable collar protocol definitions

if COLLAR_PROTOCOL

config NOFENCE_MESSAGE_EXPECTED_MAX_SIZE
	int "Expected maximum size of an encoded NofenceMessage byte array"
	default 723

endif
```

## communication/Kconfig
```kconfig
config NOFENCE_MESSAGE_EXPECTED_MAX_SIZE
int "Expected maximum size of an encoded NofenceMessage byte array"
default 723
```

## diagnostics/Kconfig
```kconfig
menuconfig DIAGNOSTICS
	bool "Diagnostics module"
	default y
	select USE_SEGGER_RTT

if DIAGNOSTICS
	config DIAGNOSTICS_RTT_DOWN_CHANNEL_INDEX
		int "RTT Channel index to use for data down to device"
		default 2
	
	config DIAGNOSTICS_RTT_UP_CHANNEL_INDEX
		int "RTT Channel index to use for data up to host computer"
		default 2

	config DIAGNOSTICS_LOG_LEVEL
		int "0 - 4 for logging. OFF -> ERR -> WRN -> INF -> DBG"
		default 3
		depends on LOG

	config DIAGNOSTICS_RTT_TIMEOUT_MS
		int "Activity timeout for RTT communication."
		default 30000

	config DIAGNOSTICS_RTT_BUFFER_SIZE
		int "Memory to allocate for each down and up buffers (memory usage will therefore be 2x)."
		default 2048

	config DIAGNOSTICS_STACK_SIZE
		int "Memory to allocate stack of handler."
		default 1024
	
	config DIAGNOSTICS_PROFILE_EVENTS
		bool "Use the diagnostics module to profile event manager event submits and execution start/stop."
		default y
	
	config DIAGNOSTICS_PARSE_BUFFER_LENGTH
		int "Maximum number of bytes in parse buffer. This sets a limits to how long each command and accompanying data can be."
		default 128
	
endif
```

## electric_pulse/Kconfig
```kconfig
# Copyright (c) 2021 Nofence AS


module = EP_MODULE
module-str = EP module
source "subsys/logging/Kconfig.template.log_config"
```

## environment/Kconfig
```kconfig
menuconfig ENV_SENSOR
	bool "Environment sensor controller for handling events"
	default y

if ENV_SENSOR
	module = ENV_SENSOR
	module-str = ENV-SENSOR
	source "subsys/logging/Kconfig.template.log_config"
endif
```

## error_handler/Kconfig
```kconfig
menuconfig ERROR_HANDLER
	bool "Error handler module"
	default y

if ERROR_HANDLER

	config ERROR_HANDLER_LOG_LEVEL
		int "0 - 4 for logging. OFF -> ERR -> WRN -> INF -> DBG"
		default 3
		depends on LOG

	config ERROR_MAX_USER_MESSAGE_SIZE
		int "How large can the user message string be."
		default 64


	config ERROR_THREAD_PRIORITY
		int "Priority of the message processing thread"
		default -3
		help
		  A cooperative thread has a negative priority value. 
		  Once it becomes the current thread, a cooperative thread 
		  remains the current thread until it performs an action 
		  that makes it unready.
		  A preemptible thread has a non-negative priority value. 
		  Once it becomes the current thread, a preemptible thread 
		  may be supplanted at any time if a cooperative thread, 
		  or a preemptible thread of higher or equal priority, 
		  becomes ready.

	config ERROR_THREAD_STACK_SIZE
		int "Size of the error thread"
		default 2048
	
	config ERROR_BLE_UART_OUTPUT_ENABLE
		bool "Enable external logging via BLE UART"
		default n
	
endif
```

## fw_upgrade/Kconfig
```kconfig
menuconfig FW_UPGRADE
	bool "Firmware upgrade module"
	default y

if FW_UPGRADE
	config SCHEDULE_REBOOT_SECONDS
	int "Schedule seconds after fw upgrade"
	help 
	  How many seconds to wait before we reboot the device, must
	  be high enough to ensure modules shut down correctly
	default 5

	config START_DL_CLIENT_STACK
    	int "stack size for start download client offload thread"
    	help
    	  stack size for a thread that will offload the event handler from starting the download client when getting a start FOTA event
    	default 1536

	config FW_UPGRADE_LOG_LEVEL
		int "0 - 4 for logging. OFF -> ERR -> WRN -> INF -> DBG"
		default 3
		depends on LOG

    config DOWNLOAD_CLIENT_OFFLOAD_THREAD_PRIO #TODO: use a lower priority
            int "thread priority for download_client start & fota cancel offload thread"
            default 1

	menu "FW_EVENTS"
	rsource "./../../events/fw_upgrade/Kconfig"
	endmenu # FW_EVENTS

	menu "ERROR_HANDLER"
    	rsource "./../../modules/error_handler/Kconfig"
	endmenu
endif
```

## gnss_controller/Kconfig
```kconfig
menuconfig GNSS_CONTROLLER
	bool "gnss controller"
	select GNSS_Drivers
	help
	  Enable gnss controller
	default y


if GNSS_CONTROLLER
    module = GNSS_CONTROLLER
        module-str = GNSS controller
        source "subsys/logging/Kconfig.template.log_config"
    config GNSS_MINIMUM_ALLOWED_GNSS_RATE
        int "Minimum allowable rate for GNSS receiver (milliseconds)"
        default 250
    config GNSS_TIMEOUTS_BEFORE_RESET
        int "Number of timeout events before we try a GNSS reset"
        default 3
    config GNSS_DEFAULT_TIMEOUT_RATE_MS
        int "Default rate to generate timeouts if GNSS receiver is missing dat (milliseconds)"
        default 5000
    config GNSS_TIMEOUT_SLACK_MS
        int "Extra milliseconds to add to the expected GNSS rate before generating a timeout event"
        default 500
    config GNSS_MAX_COUNT_INIT
        int "number of tries before gnss init retry should return -1"
        default 3
    config GNSS_CMD_RETRIES
        int "number of retries for sending a cmd to GNSS"
        default 1
    config GNSS_MAX_COUNT_SOFT_RESTART
        int "number of tries before gnss init should perform hard resetn pin toggle"
        default 3
    config GNSS_MAX_COUNT_RESETN_RESTART
        int "number of tries with resetn pin toggle before giving up"
        default 5
    config GNSS_THREAD_PRIORITY
        int "GNSS thread priority"
        default 6
    config GNSS_STACK_SIZE
        int "GNSS stack size"
        default 1280
    config GNSS_PUBLISH_STACK_SIZE
        int "GNSS publish stack size"
        default 1280
    config GNSS_ANO_THREAD_STACK_SIZE
        int "GNSS ANO thread stack size"
    	default 1536
endif
```
